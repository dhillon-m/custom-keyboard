## config/boards/shields/bhoo_20/Kconfig.defconfig
```kconfig
if SHIELD_BHOO_20

config ZMK_KEYBOARD_NAME
    default "BHOO-20"

config ZMK_SPLIT
    default y

endif
```

## config/boards/shields/macropad/Kconfig.defconfig
```kconfig
if SHIELD_MACROPAD

config ZMK_KEYBOARD_NAME
    default "Macropad"

config ZMK_SPLIT
    default y

endif
```

## config/boards/shields/macropad_test/Kconfig.defconfig
```kconfig
if SHIELD_MACROPAD_TEST

config ZMK_KEYBOARD_NAME
    default "Macropad Test"

endif
```
